## arch/arm/hotplug/Kconfig
```kconfig
config INTELLI_PLUG
        bool "Enable intelli-plug cpu hotplug driver"
        default n
        help
          Generic Intelli-plug cpu hotplug driver for ARM SOCs

config AUTOSMP
        bool "Enable autosmp cpu hotplug driver"
        default n
        help
          Generic Autosmp cpu hotplug driver for ARM SOCs

config MAKO_HOTPLUG
        bool "Enable mako-hotplug cpu hotplug driver"
        default n
        help
          Generic Mako-hotplug cpu hotplug driver for ARM SOCs

config BRICKED_HOTPLUG
        bool "Enable bricked-hotplug cpu hotplug driver"
        default n
        help
          Generic Bricked-hotplug cpu hotplug driver for ARM SOCs

config ALUCARD_HOTPLUG
		bool "Enable alucard-hotplug cpu hotplug driver"
 		default y
 		help
 	 	 Generic Alucard-hotplug cpu hotplug driver for ARM SOCs

config MSM_SLEEPER
		bool "CPU hotplug driver(MSM sleeper)"
		default n
		help
	  	 CPU hotplug driver
```

## drivers/performance/Kconfig
```kconfig
config MSM_PERFORMANCE
	tristate "Core control driver to support userspace hotplug requests"
	help
	  This driver is used to provide CPU hotplug support to userspace.
	  It ensures that no more than a user specified number of CPUs stay
	  online at any given point in time.

config MSM_PERFORMANCE_HOTPLUG_ON
    bool "Hotplug functionality through msm_performance turned on"
    depends on MSM_PERFORMANCE
    default y
    help
	  If some other core-control driver is present turn off the core-control 
	  capability of msm_performance driver. Setting this flag to false will 
	  compile out the nodes needed for core-control functionality through msm_performance.
```
